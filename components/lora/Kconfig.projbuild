## components/lora/Kconfig.projbuild
```kconfig
menu "LoRa Configuration"

	config GPIO_RANGE_MAX
		int
		default 33 if IDF_TARGET_ESP32
		default 46 if IDF_TARGET_ESP32S2
		default 48 if IDF_TARGET_ESP32S3
		default 18 if IDF_TARGET_ESP32C2
		default 19 if IDF_TARGET_ESP32C3
		default 30 if IDF_TARGET_ESP32C6

	config MISO_GPIO
		int "MISO GPIO"
		range 0 GPIO_RANGE_MAX
		default 19 if IDF_TARGET_ESP32
		default 37 if IDF_TARGET_ESP32S2 || IDF_TARGET_ESP32S3
		default  4 # C3 and others
		help
			Pin Number to be used as the MISO SPI signal.

	config SCK_GPIO
		int "SCK GPIO"
		range 0 GPIO_RANGE_MAX
		default 18 if IDF_TARGET_ESP32
		default 36 if IDF_TARGET_ESP32S2 || IDF_TARGET_ESP32S3
		default  5 # C3 and others
		help
			Pin Number to be used as the SCK SPI signal.

	config MOSI_GPIO
		int "MOSI GPIO"
		range 0 GPIO_RANGE_MAX
		default 23 if IDF_TARGET_ESP32
		default 35 if IDF_TARGET_ESP32S2 || IDF_TARGET_ESP32S3
		default  6 # C3 and others
		help
			Pin Number to be used as the MOSI SPI signal.

	config CS_GPIO
		int "NSS GPIO"
		range 0 GPIO_RANGE_MAX
		default 15 if IDF_TARGET_ESP32
		default 34 if IDF_TARGET_ESP32S2 || IDF_TARGET_ESP32S3
		default  7 # C3 and others
		help
			Pin Number where the NCS pin of the LoRa module is connected to.

	config RST_GPIO
		int "RST GPIO"
		range 0 GPIO_RANGE_MAX
		default 16 if IDF_TARGET_ESP32
		default 38 if IDF_TARGET_ESP32S2 || IDF_TARGET_ESP32S3
		default  3 # C3 and others
		help
			Pin Number where the NRST pin of the LoRa module is connected to.

	choice SPI_HOST
		prompt "SPI peripheral that controls this bus"
		default SPI2_HOST
		help
			Select SPI peripheral that controls this bus.
		config SPI2_HOST
			bool "SPI2_HOST"
			help
				Use SPI2_HOST. This is also called HSPI_HOST.
		config SPI3_HOST
			depends on IDF_TARGET_ESP32 || IDF_TARGET_ESP32S2 || IDF_TARGET_ESP32S3
			bool "SPI3_HOST"
			help
				USE SPI3_HOST. This is also called VSPI_HOST
	endchoice

endmenu
```

## nimble/main/Kconfig.projbuild
```kconfig
menu "Application Configuration"

	choice DIRECTION
		prompt "Communication polarity"
		default SENDER
		help
			Select Communication polarity.
		config SENDER
			bool "BLE to LoRa"
			help
				BLE to LoRa.
		config RECEIVER
			bool "LoRa to BLE"
			help
				LoRa to BLE.
	endchoice

endmenu 
```

## ping-pong/main/Kconfig.projbuild
```kconfig
menu "Application Configuration"

	choice POLARITY
		prompt "Communication Polarity"
		default Primary
		help
			Select Communication Polarity.
		config PRIMARY
			bool "Primary"
			help
				As Echo Client.
		config SECONDARY
			bool "Secondary"
			help
				As Echo Server.
	endchoice

	choice FREQUENCY
		prompt "Frequency to use"
		default 433MHZ
		help
			Select Frequency to use.
		config 169MHZ
			bool "169MHz"
			help
				Frequency is 169MHz.
		config 433MHZ
			bool "433MHz"
			help
				Frequency is 433MHz.
		config 470MHZ
			bool "470MHz"
			help
				Frequency is 470MHz.
		config 866MHZ
			bool "866MHz"
			help
				Frequency is 866MHz.
		config 915MHZ
			bool "915MHz"
			help
				Frequency is 915MHz.
		config OTHER
			bool "Other"
			help
				Other Frequency.
	endchoice

	config OTHER_FREQUENCY
		depends on OTHER
		int "Frequency to use[MHz]"
		range 1 999
		help
			Frequency to use[MHz].

endmenu 
```

## ssl/main/Kconfig.projbuild
```kconfig
menu "Application Configuration"

	menu "WiFi Setting"

		config ESP_WIFI_SSID
			string "WiFi SSID"
			default "myssid"
			help
				SSID (network name) for the example to connect to.

		config ESP_WIFI_PASSWORD
			string "WiFi Password"
			default "mypassword"
			help
				WiFi password (WPA or WPA2) for the example to use.

		config ESP_MAXIMUM_RETRY
			int "Maximum retry"
			default 5
			help
				Set the Maximum retry to avoid station reconnecting to the AP unlimited when the AP is really inexistent.

	endmenu

	menu "Server Setting"

		config SSL_SERVER_HOST
			string "server to connect to"
			default "192.168.0.100"
			help
				server to connect to.

		config SSL_SERVER_PORT
			int "port to connect to"
			default 8080
			help
				port to connect to.

	endmenu

endmenu 
```

## web-form/main/Kconfig.projbuild
```kconfig
menu "Application Configuration"

	menu "WiFi Setting"

		config ESP_WIFI_SSID
			string "WiFi SSID"
			default "myssid"
			help
				SSID (network name) for the example to connect to.

		config ESP_WIFI_PASSWORD
			string "WiFi Password"
			default "mypassword"
			help
				WiFi password (WPA or WPA2) for the example to use.

		config ESP_MAXIMUM_RETRY
			int "Maximum retry"
			default 5
			help
				Set the Maximum retry to avoid station reconnecting to the AP unlimited when the AP is really inexistent.

		config MDNS_HOSTNAME
			string "mDNS Hostname"
			default "esp32-server"
			help
				The mDNS host name used by the ESP32.

	endmenu

	menu "Radio Setting"

		choice DIRECTION
			prompt "Communication polarity"
			default SENDER
			help
				Select Communication polarity.
			config SENDER
				bool "WEB to LoRa"
				help
					WEB to LoRa.
			config RECEIVER
				bool "LoRa to WEB"
				help
					LoRa to WEB.
		endchoice

	endmenu

endmenu 
```
